## config/west.yml
```yaml
manifest:
  remotes:
    - name: zmkfirmware
      url-base: https://github.com/zmkfirmware
    - name: refil
      url-base: https://github.com/refil
    - name: zmk-locales
      url-base: https://github.com/joelspadin
  projects:
    - name: zmk
      remote: refil
      revision: adv360-z3.5
      import: app/west.yml
    - name: zmk-locales
      remote: zmk-locales
      revision: main
  self:
    path: config
```
